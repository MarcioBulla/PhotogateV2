## firmware/main/Kconfig.projbuild
```kconfig
menu "Photogate V2.1 config"

    menu "Display & I2C"
        config DISPLAY_COLUMNS
            int "Set Horizontal number of characters for your display"
            default 20
            help
                Configure the number of columns (horizontal characters) for the LCD display.
                Common values: 16, 20, or 24 characters.

        config DISPLAY_ROWS
            int "Set Vertical number of characters for your display"
            default 4
            help
                Configure the number of rows (vertical characters) for the LCD display.
                Common values: 2 or 4 rows.

        config I2C_SDA
            int "Set I2C pin SDA number"
            default 21
            help
                GPIO pin number for I2C Serial Data (SDA) line.
                Used for communication with LCD display via I2C.

        config I2C_SCL
            int "Set I2C pin SCL number"
            default 22
            help
                GPIO pin number for I2C Serial Clock (SCL) line.
                Used for communication with LCD display via I2C.

        config PWM_DISPLAY
            int "Set pin of the PWM that controls display backlight"
            default 19
            help
                GPIO pin number for PWM control of LCD backlight brightness.

        config DISPLAY_ADDR
            hex "Set Address of PCF8574 I2C expander"
            default 0x27
            help
                I2C address of the PCF8574 I2C-to-parallel expander chip.
                Common addresses: 0x27, 0x3F, 0x20-0x27.
    endmenu

    menu "Encoder"
        config ENCODER_CLK
            int "Set CLK pin Rotary Encoder"
            default 16
            help
                GPIO pin number for rotary encoder clock signal.

        config ENCODER_DT
            int "Set DT pin Rotary Encoder"
            default 17
            help
                GPIO pin number for rotary encoder data signal.

        config ENCODER_SW
            int "Set SW pin Rotary Encoder"
            default 18
            help
                GPIO pin number for rotary encoder switch (button press).

        config ENCODER_DOUBLE_SIGNAL
            bool "If your encoder sends double signal to one movement"
            default true
            help
                Enable this if your rotary encoder generates two pulses per detent.
                This provides better resolution but may cause double counting.
    endmenu

    menu "Sensor"
        config SENSOR_IR
            int "Set Sensor pin"
            default 23
            help
                GPIO pin number for the infrared photogate sensor input.
    endmenu

    menu "Experiments"
        config PENDULUM
            int "Set Default Pendulum's periods"
            default 5
            help
                Default number of oscillation periods to measure for pendulum experiments.

        config SPRING
            int "Set Default Spring's periods"
            default 1
            help
                Default number of oscillation periods to measure for spring experiments.

        choice ENERGY_TYPE
            prompt "Set shape of the cylinder for energy calculations"
            default ENERGY_SOLID
            help
                Select the cylinder type for moment of inertia calculations.

            config ENERGY_SOLID
                bool "Solid cylinder"
                help
                    Solid cylinder: I = (1/2) * m * r²

            config ENERGY_HOLLOW_RI_RE
                bool "Hollow cylinder with inner and outer radius (Ri+Re)"
                help
                    Hollow cylinder with both radii: I = (1/2) * m * (Ri² + Re²)

            config ENERGY_HOLLOW_2RE
                bool "Hollow cylinder with outer diameter only (2Re)"
                help
                    Hollow cylinder, outer diameter only: I = m * Re²

            config ENERGY_HOLLOW_2RI
                bool "Hollow cylinder with inner diameter only (2Ri)"
                help
                    Hollow cylinder, inner diameter only: I = m * Ri²
        endchoice

        config ENERGY
            int
            default 0 if ENERGY_SOLID
            default 1 if ENERGY_HOLLOW_RI_RE
            default 2 if ENERGY_HOLLOW_2RE
            default 3 if ENERGY_HOLLOW_2RI
            help
                Internal config that maps the cylinder type selection to numeric values.
                This config is automatically set based on the ENERGY_TYPE choice.

        config CENTRIPETAL
            int "Set Default Centripetal's periods"
            default 2
            help
                Default number of periods to measure for centripetal force experiments.

        menu "Classic"
            config CLASSIC_PEND_ENABLE
                bool "Default PEND's option: READ"
                default y
                help
                    Enable or disable the classic pendulum experiment mode.

            config CLASSIC_PEND
                int
                default 0 if CLASSIC_PEND_ENABLE
                default 1 if !CLASSIC_PEND_ENABLE
                help
                    Internal config for classic pendulum: 0=enabled, 1=disabled.

            config CLASSIC_PULSE_ENABLE
                bool "Default PULSE's option: READ"
                default y
                help
                    Enable or disable the classic pulse experiment mode.

            config CLASSIC_PULSE
                int
                default 0 if CLASSIC_PULSE_ENABLE
                default 1 if !CLASSIC_PULSE_ENABLE
                help
                    Internal config for classic pulse: 0=enabled, 1=disabled.

            config CLASSIC_GATE_ENABLE
                bool "Default GATE's option: READ"
                default y
                help
                    Enable or disable the classic photogate experiment mode.

            config CLASSIC_GATE
                int
                default 0 if CLASSIC_GATE_ENABLE
                default 1 if !CLASSIC_GATE_ENABLE
                help
                    Internal config for classic gate: 0=enabled, 1=disabled.
        endmenu
    endmenu

endmenu
```
